/*
 * KaSe V1 physical key layout — V1 internal matrix coordinates.
 * Transposed from the canonical V2 layout via v2_to_v1 position mapping.
 *
 * Format v2: direct x/y positioning with optional rotation (r) and width (w).
 * Top-level "keys" = individually positioned keys (thumbs, inner columns).
 * "groups" = vertical columns sharing a common origin and rotation.
 *
 * Requires: PRODUCT_NAME, MATRIX_ROWS, MATRIX_COLS, STR() defined.
 */
const char board_layout_json[] =
"{"
  "\"name\":\"" PRODUCT_NAME "\","
  "\"rows\":" STR(MATRIX_ROWS) ","
  "\"cols\":" STR(MATRIX_COLS) ","
  "\"keys\":["
    "{\"row\":0,\"col\":12,\"x\":6.05,\"y\":3.6,\"r\":10.0},"
    "{\"row\":4,\"col\":2,\"x\":2.2,\"y\":4.6,\"w\":1.2},"
    "{\"row\":4,\"col\":3,\"x\":3.48,\"y\":4.7,\"r\":10.0},"
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    "{\"row\":2,\"col\":12,\"x\":7.95,\"y\":3.6,\"r\":-10.0}"
  "],"
  "\"groups\":["
    "{\"x\":0.0,\"y\":0.0,\"keys\":["
      "{\"row\":0,\"col\":0,\"x\":0,\"y\":0},"
      "{\"row\":1,\"col\":0,\"x\":0,\"y\":1},"
      "{\"row\":2,\"col\":0,\"x\":0,\"y\":2},"
      "{\"row\":3,\"col\":0,\"x\":0,\"y\":3},"
      "{\"row\":4,\"col\":0,\"x\":0,\"y\":4}"
    "]},"
    "{\"x\":1,\"y\":0.0,\"keys\":["
      "{\"row\":0,\"col\":1,\"x\":0,\"y\":0},"
      "{\"row\":1,\"col\":1,\"x\":0,\"y\":1},"
      "{\"row\":2,\"col\":1,\"x\":0,\"y\":2},"
      "{\"row\":3,\"col\":1,\"x\":0,\"y\":3},"
      "{\"row\":4,\"col\":1,\"x\":0,\"y\":4}"
    "]},"
    "{\"x\":2.3,\"y\":0.5,\"r\":5,\"keys\":["
      "{\"row\":0,\"col\":2,\"x\":0,\"y\":0},"
      "{\"row\":1,\"col\":2,\"x\":0,\"y\":1},"
      "{\"row\":2,\"col\":2,\"x\":0,\"y\":2},"
      "{\"row\":3,\"col\":2,\"x\":0,\"y\":3}"
    "]},"
    "{\"x\":3.6,\"y\":0.4,\"r\":10,\"keys\":["
      "{\"row\":0,\"col\":3,\"x\":0,\"y\":0},"
      "{\"row\":1,\"col\":3,\"x\":0,\"y\":1},"
      "{\"row\":2,\"col\":3,\"x\":0,\"y\":2},"
      "{\"row\":3,\"col\":3,\"x\":0,\"y\":3}"
    "]},"
    "{\"x\":4.55,\"y\":0.8,\"r\":10,\"keys\":["
      "{\"row\":0,\"col\":4,\"x\":0,\"y\":0},"
      "{\"row\":1,\"col\":4,\"x\":0,\"y\":1},"
      "{\"row\":2,\"col\":4,\"x\":0,\"y\":2},"
      "{\"row\":3,\"col\":4,\"x\":0,\"y\":3}"
    "]},"
    "{\"x\":5.5,\"y\":1,\"r\":10,\"keys\":["
      "{\"row\":0,\"col\":5,\"x\":0,\"y\":0},"
      "{\"row\":1,\"col\":5,\"x\":0,\"y\":1},"
      "{\"row\":2,\"col\":5,\"x\":0,\"y\":2},"
      "{\"row\":3,\"col\":5,\"x\":0,\"y\":3}"
    "]},"
    "{\"x\":8.5,\"y\":1,\"r\":-10,\"keys\":["
      "{\"row\":0,\"col\":6,\"x\":0,\"y\":0},"
      "{\"row\":1,\"col\":6,\"x\":0,\"y\":1},"
      "{\"row\":2,\"col\":6,\"x\":0,\"y\":2},"
      "{\"row\":3,\"col\":6,\"x\":0,\"y\":3}"
    "]},"
    "{\"x\":9.5,\"y\":0.8,\"r\":-10,\"keys\":["
      "{\"row\":0,\"col\":7,\"x\":0,\"y\":0},"
      "{\"row\":1,\"col\":7,\"x\":0,\"y\":1},"
      "{\"row\":2,\"col\":7,\"x\":0,\"y\":2},"
      "{\"row\":3,\"col\":7,\"x\":0,\"y\":3}"
    "]},"
    "{\"x\":10.4,\"y\":0.3,\"r\":-10,\"keys\":["
      "{\"row\":0,\"col\":8,\"x\":0,\"y\":0},"
      "{\"row\":1,\"col\":8,\"x\":0,\"y\":1},"
      "{\"row\":2,\"col\":8,\"x\":0,\"y\":2},"
      "{\"row\":3,\"col\":8,\"x\":0,\"y\":3}"
    "]},"
    "{\"x\":11.7,\"y\":0.5,\"r\":-5,\"keys\":["
      "{\"row\":0,\"col\":9,\"x\":0,\"y\":0},"
      "{\"row\":1,\"col\":9,\"x\":0,\"y\":1},"
      "{\"row\":2,\"col\":9,\"x\":0,\"y\":2},"
      "{\"row\":3,\"col\":9,\"x\":0,\"y\":3}"
    "]},"
    "{\"x\":13,\"y\":0.0,\"keys\":["
      "{\"row\":1,\"col\":10,\"x\":0,\"y\":1},"
      "{\"row\":2,\"col\":10,\"x\":0,\"y\":2},"
      "{\"row\":3,\"col\":10,\"x\":0,\"y\":3},"
      "{\"row\":4,\"col\":9,\"x\":0,\"y\":4}"
    "]},"
    "{\"x\":14,\"y\":0.0,\"keys\":["
      "{\"row\":0,\"col\":10,\"x\":0,\"y\":0},"
      "{\"row\":1,\"col\":11,\"x\":0,\"y\":1},"
      "{\"row\":2,\"col\":11,\"x\":0,\"y\":2},"
      "{\"row\":3,\"col\":11,\"x\":0,\"y\":3},"
      "{\"row\":4,\"col\":11,\"x\":0,\"y\":4}"
    "]}"
  "]"
"}"
;
