/*
 * KaSe split-wireless physical key layout — dongle (full keyboard view).
 * GENERATED from the controller app export (~/Downloads/layout.json).
 * Edit visually in the controller software and re-export, rather than by hand.
 * Embedded as board_layout_json[] (served by GET_LAYOUT_JSON 0x22).
 * Requires: PRODUCT_NAME, MATRIX_ROWS, MATRIX_COLS, STR() defined.
 */
const char board_layout_json[] =
"{"
  "\"name\":\"" PRODUCT_NAME "\","
  "\"rows\":" STR(MATRIX_ROWS) ","
  "\"cols\":" STR(MATRIX_COLS) ","
  "\"keys\":["
    "{\"row\":4,\"col\":6,\"x\":6,\"y\":2.3,\"w\":1,\"h\":1,\"r\":0},"
    "{\"row\":3,\"col\":6,\"x\":7,\"y\":4.3,\"w\":1,\"h\":1,\"r\":0},"
    "{\"row\":2,\"col\":6,\"x\":7,\"y\":2.3,\"w\":1,\"h\":1,\"r\":0},"
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    "{\"row\":0,\"col\":7,\"x\":10.5,\"y\":3.3,\"w\":1,\"h\":1,\"r\":0}"
  "]"
"}"
;
