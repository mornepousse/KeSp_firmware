## sdkconfig.defaults
```kconfig
# KaSe firmware defaults — source of truth for sdkconfig.
# Generated via `idf.py save-defconfig` + manual additions.

# Disable UART console — frees GPIO43/44/16 (UART0) used by V2 matrix
CONFIG_ESP_CONSOLE_NONE=y

# TinyUSB: keyboard + mouse HID, CDC ACM with generous buffers
CONFIG_TINYUSB_CDC_ENABLED=y
CONFIG_TINYUSB_CDC_COUNT=1
CONFIG_TINYUSB_HID_COUNT=1
CONFIG_TINYUSB_CDC_RX_BUFSIZE=512
# TX ring must hold a whole KR frame in one queue+flush. The dongle relays a
# reassembled tunnel response (e.g. the ~4.5KB layout JSON) via cdc_send_binary in
# one shot from the WiFi recv callback (can't loop/flush there), so 512 truncated
# it. 8192 covers CFG_FRAME_MAX (6144) + margin.
CONFIG_TINYUSB_CDC_TX_BUFSIZE=8192
CONFIG_TINYUSB_CDC_EP_BUFSIZE=512

# Flash size + custom partition table
CONFIG_ESPTOOLPY_FLASHSIZE_16MB=y
CONFIG_PARTITION_TABLE_CUSTOM=y
CONFIG_PARTITION_TABLE_CUSTOM_FILENAME="partitions.csv"

# Bluetooth: BLE HID only (no Classic)
CONFIG_BT_ENABLED=y
CONFIG_BT_BLE_ENABLED=y
CONFIG_BT_HID_ENABLED=y
CONFIG_BT_HID_DEVICE_ENABLED=y
CONFIG_BT_BLUEDROID_ENABLED=y
CONFIG_BT_CONTROLLER_ENABLED=y
CONFIG_BT_GATTS_ENABLE=y
CONFIG_BT_GATTC_ENABLE=y
CONFIG_BT_BLE_SMP_ENABLE=y
CONFIG_BT_BLE_SMP_BOND_NVS_FLASH=y
# Legacy BLE 4.2 GAP APIs (esp_ble_gap_start_advertising / config_adv_data) — the
# keyboard BLE HID code uses these. ESP-IDF 5.5 defaults to BLE 5.0-only, which
# omits them → undefined references at link. Enable the 4.2 feature set.
CONFIG_BT_BLE_42_FEATURES_SUPPORTED=y

# LVGL: 16-bit color, required fonts
CONFIG_LV_COLOR_16_SWAP=y
CONFIG_LV_COLOR_DEPTH_16=y
CONFIG_LV_FONT_MONTSERRAT_14=y
CONFIG_LV_FONT_MONTSERRAT_28=y
CONFIG_LV_FONT_MONTSERRAT_48=y
CONFIG_LV_FONT_UNSCII_8=y
```

## sdkconfig.defaults.dongle
```kconfig
# KaSe dongle board overrides — merged on top of sdkconfig.defaults

# --- Device role ---
CONFIG_KASE_DEVICE_ROLE_DONGLE=y

# --- Bluetooth disabled (saves ~80KB heap, no BLE on dongle) ---
CONFIG_BT_ENABLED=n

# --- WiFi enabled for ESP-NOW (Plan 5), STA mode no AP ---
CONFIG_ESP_WIFI_ENABLED=y
CONFIG_ESP_WIFI_NVS_ENABLED=n

# --- Power management off (USB powered, no battery) ---
CONFIG_PM_ENABLE=n

# --- FreeRTOS tick = 1ms (matches latency budget in spec Section 3) ---
CONFIG_FREERTOS_HZ=1000

# --- Network stack minimal (no TCP/IP needed) ---
CONFIG_LWIP_TCP_ENABLED=n
CONFIG_LWIP_UDP_ENABLED=n
CONFIG_LWIP_IPV6=n

# --- Logs : WARN in prod (dongle is a sealed M.2 device, no console) ---
CONFIG_LOG_DEFAULT_LEVEL_WARN=y
# Console inherits CONFIG_ESP_CONSOLE_NONE from base. For dongle bring-up,
# temporarily add CONFIG_ESP_CONSOLE_UART_DEFAULT=y + rm sdkconfig + rebuild.
# NRF radio bring-up on a fresh board: add CONFIG_ESP_CONSOLE_UART_DEFAULT=y +
# CONFIG_KASE_NRF_LINE_TEST=y, rebuild, flash, read /dev/ttyUSB0 (CH340). It runs
# a bidirectional short test on the 9 NRF lines at boot and logs any solder bridge
# (tag "rf_line_test"), then probe csn=.. -> OK once the radios answer on SPI.

# --- TinyUSB : descriptors specific to dongle (CDC/HID enable in base defaults) ---
CONFIG_TINYUSB_DESC_USE_ESPRESSIF_VID=y
CONFIG_TINYUSB_DESC_USE_DEFAULT_PID=y
CONFIG_TINYUSB_DESC_BCD_DEVICE=0x0100
CONFIG_TINYUSB_DESC_MANUFACTURER_STRING="KaSe"
CONFIG_TINYUSB_DESC_PRODUCT_STRING="KaSe Dongle"
CONFIG_TINYUSB_DESC_SERIAL_STRING="dongle-v1"
CONFIG_TINYUSB_DESC_CDC_STRING="KaSe Dongle CDC"
# Dongle needs 2 HID instances: instance 0 = kbd/mouse, instance 1 = OTP
CONFIG_TINYUSB_HID_COUNT=2
# HID_COUNT=2 covers the OTP personality (instance 1). Under OPENPGP/NONE
# instance 1 is simply unused (a few bytes of RAM).

# --- Dongle security personality — PGP GELÉ 2026-07-04 : personnalité NONE,
# toute la surface OpenPGP (CCID / openpgp_card / crypto / DO) est compilée out.
# Réactivation = CONFIG_KASE_SEC_OPENPGP=y (+ default Kconfig) puis rm sdkconfig.
# Les blobs NVS pgp_keys/pins/dos restent dormants (chiffrés, jamais relus). ---
CONFIG_KASE_SEC_NONE=y

# --- ⚠️ DURCISSEMENT DÉSACTIVÉ « pour l'instant » (2026-07-04, demande Mae) ---
# Le dongle physique tourne en config DEV NON durcie : NVS EN CLAIR, PAS de secure
# boot, partitions STANDARD (partitions.csv héritée de sdkconfig.defaults → table à
# PT 0x8000, factory app @ 0x20000). Vérifié par dump flash du device 2026-07-04.
# Les réglages ci-dessous sont la CIBLE de durcissement (différée). NE PAS les
# réactiver sans reflasher le dongle en conséquence : le secure boot repousse la
# table à 0x10000 (partitions_dongle.csv) → si le device est encore en 0x8000, un
# app-flash écrit l'app au mauvais offset et la corrompt (bug vécu 2026-07-04).
# Réactivation NVS-enc seule : décommenter les 3 CONFIG_NVS_* (n'exige pas de reflow).
# Réactivation Secure Boot : décommenter le bloc complet + full flash cohérent.
# CONFIG_NVS_ENCRYPTION=y
# CONFIG_NVS_SEC_KEY_PROTECT_USING_HMAC=y
# CONFIG_NVS_SEC_HMAC_EFUSE_KEY_ID=0
# CONFIG_SECURE_BOOT=y
# CONFIG_SECURE_BOOT_V2_ENABLED=y
# CONFIG_SECURE_BOOT_V2_RSA_ENABLED=y
# CONFIG_SECURE_BOOT_SIGNING_KEY="secure_boot_signing_key.pem"
# CONFIG_SECURE_BOOT_BUILD_SIGNED_BINARIES=y
# CONFIG_PARTITION_TABLE_CUSTOM_FILENAME="partitions_dongle.csv"
# CONFIG_PARTITION_TABLE_OFFSET=0x10000
```

## sdkconfig.defaults.half_right
```kconfig
# KaSe half_left board overrides — merged on top of sdkconfig.defaults

# --- Device role ---
CONFIG_KASE_DEVICE_ROLE_HALF=y

# --- Console UART active (GPIO43/44 not used by matrix on half) ---
# This differs from the dongle which uses CONFIG_ESP_CONSOLE_NONE=y.
CONFIG_ESP_CONSOLE_UART_DEFAULT=y

# --- Bluetooth disabled (not used in MVP; saves ~80KB heap) ---
CONFIG_BT_ENABLED=n
CONFIG_BT_CONTROLLER_ENABLED=n
CONFIG_BT_BLUEDROID_ENABLED=n

# --- WiFi enabled for ESP-NOW info channel (plan bricks-3) ---
# ESP-NOW requires the WiFi radio. No AP, no IP, no credentials stored.
# Memory impact: +60-80 KB heap (ESP32-S3 has 512 KB SRAM — acceptable).
# Power impact: +10-20 mA (modem sleep pending power-management brick).
# Channel: 6 (2437 MHz) — 29 MHz below NRF24 left at 2476 MHz (strategy A, spec §8.1).
# See docs/superpowers/specs/2026-05-22-half-peripherals-espnow-design.md §8.4.
CONFIG_ESP_WIFI_ENABLED=y
CONFIG_ESP_WIFI_NVS_ENABLED=n
CONFIG_ESP_WIFI_SOFTAP_SUPPORT=n
CONFIG_ESP_WIFI_ENTERPRISE_SUPPORT=n

# --- Power management off (simpler for MVP; light-sleep deferred) ---
CONFIG_PM_ENABLE=n

# --- FreeRTOS tick = 1 ms (matches keyboard latency targets) ---
CONFIG_FREERTOS_HZ=1000

# --- TinyUSB: CDC only for flash/console — NO HID on half ---
CONFIG_TINYUSB_CDC_ENABLED=y
CONFIG_TINYUSB_HID_ENABLED=n

# --- CPU 240 MHz fixed (power management off) ---
CONFIG_ESP32S3_DEFAULT_CPU_FREQ_240=y

# --- LVGL: 1bpp monochrome for SSD1681 e-ink ---
CONFIG_LV_COLOR_DEPTH_1=y
CONFIG_LV_USE_LABEL=y
CONFIG_LV_FONT_MONTSERRAT_14=y
CONFIG_LV_FONT_MONTSERRAT_28=y
CONFIG_LV_FONT_UNSCII_8=y
```
